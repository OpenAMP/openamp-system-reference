## CMakeLists.txt
```
# Copyright (c) 2023 Linaro
# SPDX-License-Identifier: Apache-2.0
cmake_minimum_required(VERSION 3.20.0)

find_package(Zephyr REQUIRED HINTS $ENV{ZEPHYR_BASE})
project(openamp_rpmsg_over_ivshmem_remote)

target_include_directories(app PRIVATE ../rpmsg_ivshmem_backend)

target_sources(app PRIVATE
        src/main.c
        ../rpmsg_ivshmem_backend/rpmsg_ivshmem_backend.c)
```

## prj.conf
```kconfig
# Copyright (c) 2023 Linaro
# SPDX-License-Identifier: Apache-2.0

CONFIG_PCIE=y
# required by doorbell
CONFIG_PCIE_MSI=y
CONFIG_PCIE_MSI_X=y
CONFIG_PCIE_MSI_MULTI_VECTOR=y
CONFIG_POLL=y

CONFIG_VIRTUALIZATION=y
CONFIG_IVSHMEM=y
CONFIG_IVSHMEM_DOORBELL=y

CONFIG_SHELL=y
CONFIG_IVSHMEM_SHELL=n
CONFIG_OPENAMP=y
CONFIG_OPENAMP_MASTER=n
```

## boards/qemu_cortex_a53.conf
```kconfig
# Copyright (c) 2023 Linaro
# SPDX-License-Identifier: Apache-2.0

CONFIG_PCIE_CONTROLLER=y
CONFIG_PCIE_ECAM=y

# Hungry PCI requires at least 256M of virtual space
CONFIG_KERNEL_VM_SIZE=0x80000000

# Hungry PCI requires phys addresses with more than 32 bits
CONFIG_ARM64_VA_BITS_40=y
CONFIG_ARM64_PA_BITS_40=y

# MSI support requires ITS
CONFIG_GIC_V3_ITS=y

# ITS, in turn, requires dynamic memory (9x64 + alignment constrains)
# Additionally, our test also uses malloc
CONFIG_HEAP_MEM_POOL_SIZE=1048576
```

## app.overlay
```dts
/*
 * Copyright 2023 Linaro.
 *
 * SPDX-License-Identifier: Apache-2.0
 */
#include "boards/pcie_ivshmem.dtsi"
```

## src/main.c
```c
/*
 * Copyright (c) 2023, Linaro Limited
 *
 * SPDX-License-Identifier: Apache-2.0
 */
#include <stdio.h>

#include <zephyr/kernel.h>
#include <openamp/open_amp.h>
#include "rpmsg_ivshmem_backend.h"

static struct rpmsg_endpoint remote_ept;
static struct rpmsg_device *rpmsg_dev;

int endpoint_cb(struct rpmsg_endpoint *ept, void *data,
		size_t len, uint32_t src, void *priv)
{
	printf("Host side sent a string:\n");
	printf("[ %s ]\n", (const char *)data);
	printf("Now echoing it back!\n\n");

	int status = rpmsg_send(&remote_ept, data, len);

	if (status < 0)
		printf("failed to send message to the Host side: %d\n", status);

	return RPMSG_SUCCESS;
}

static void rpmsg_service_unbind(struct rpmsg_endpoint *ept)
{
}

int main(void)
{
	rpmsg_dev = get_rpmsg_ivshmem_device();

	if (!rpmsg_dev) {
		printf("Could not get the RPMsg device for IVSHMEM backend!\n");
		return -1;
	}

	/* Setup the endpoint, this will notify the host side and allow it
	 * to finish the RPMsg communication estabilishement.
	 */
	int status = rpmsg_create_ept(&remote_ept, rpmsg_dev, "k", RPMSG_ADDR_ANY,
			RPMSG_ADDR_ANY, endpoint_cb, rpmsg_service_unbind);
	if (status != 0) {
		printf("rpmsg_create_ept failed %d\n", status);
		return status;
	}

	printf("Remote Side, the communication over RPMsg is ready to use!\n");

	return 0;
}
```
