## examples/legacy_apps/west.yml
```yaml
# Copyright (c) 2022 STMicroelectronics
# SPDX-License-Identifier: Apache-2.0

manifest:
  remotes:
    - name: openamp
      url-base: https://github.com/OpenAMP
  defaults:
    remote: openamp

  self:
    path: openamp-system-reference

  projects:
    - name: libmetal
      revision: main

    - name: open-amp
      revision: main
```

## examples/zephyr/virtio_mmio_devices/zephyr_virtio_device/drivers/i2c/Kconfig.virtio
```kconfig
# Kconfig - I2C Slave VIRTIO driver

# Copyright (c) 2023, STMICROLECTRONICS
#
# SPDX-License-Identifier: Apache-2.0

if VIRTIO

config I2C_VIRTIO_DEV
	bool "I2C Slave VIRTIO driver"
	select CONFIG_OPENAMP
	default n
	help
	  Enable virtual I2C Slave VIRTIO driver

endif # VIRTIO
```

## examples/zephyr/virtio_mmio_devices/zephyr_virtio_device/drivers/virtio/Kconfig.virtio
```kconfig
# virtio configuration options
#
# Copyright (c) 2023, STMICROLECTRONICS
#
# SPDX-License-Identifier: Apache-2.0
#
menuconfig VIRTIO
	bool "VirtIO devices and drivers"
	help
	  Enable VIRTIO Driver Configuration

if VIRTIO

config VIRTIO_MMIO_DEV
	bool "virtio mmio device"
	select CONFIG_OPENAMP
	default n
	help
	  Enable virtio mmio device driver

endif # VIRTIO
```

## west.yml
```yaml
# Copyright (c) 2022 STMicroelectronics
# SPDX-License-Identifier: Apache-2.0

manifest:
  remotes:
    - name: openamp
      url-base: https://github.com/OpenAMP
    - name: zephyr
      url-base: https://github.com/zephyrproject-rtos
  defaults:
    remote: openamp

  self:
    path: openamp-system-reference

  projects:
    - name: zephyr
      remote: zephyr
      revision: v3.5.0
      import: true

    # as we use the same names as in the zephyr manifest,
    # our definitions eclipse their's
    - name: libmetal
      revision: v2024.05.0

    - name: open-amp
      revision: v2024.05.1

    # however, our version does not have the zephyr module glue
    # so bring in our custom version that integrates both libraries
    # as a single zephyr module
    - name: openamp-zephyr-modules
      revision: main
```
